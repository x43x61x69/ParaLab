SECTIONS {
.p18dc4 0x10018dc4 : { *(.p18dc4) }
.p35c68 0x10035c68 : { *(.p35c68) }
.p537a4 0x100537a4 : { *(.p537a4) }
.p98000 0x10098000 : { *(.p98000) }
}
edge = 0x100055ed; sound = 0x100167d9; draw = 0x10095001;
